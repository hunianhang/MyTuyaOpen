## apps/tuya.ai/your_life_companion/Kconfig
```kconfig
menu "configure app (your_life_companion) "

config TUYA_PRODUCT_ID
    string "product ID of project"
    default "p320pepzvmm1ghse"

config ENABLE_BATTERY
    bool "enable the battery module"
    default n

rsource "../ai_components/Kconfig"
rsource "src/display2/Kconfig"

endmenu
```
